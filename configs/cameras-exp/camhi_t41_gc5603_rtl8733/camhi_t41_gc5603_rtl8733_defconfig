## configs/cameras-exp/camhi_t41_gc5603_rtl8733/camhi_t41_gc5603_rtl8733_defconfig
```kconfig
# NAME: Vanhua Z66SI (T41NQ, GC4023, ETH)
# FRAG: soc-xburst2 toolchain-xburst2 ccache brand rootfs kernel system target uboot ssl

# 38 39 40 41 disrupt the network sensor: reset PC28 (92) cim PA15 (15)
# stock FW psw HI2105CHIP
# setenv ipaddr 192.168.1.244;setenv serverip 192.168.1.159;env save
# tftpboot 0x80600000 thingino-camhi_t41_gc5603_rtl8733.bin
# s#f probe; sf erase 0x0 0x1000000;sf write 0x80600000 0x0 0x1000000
# sf probe; sf erase 0x0 0x1000000;sf write ${baseaddr} 0x0 ${filesize}
# rootfs.bin
# sf probe; sf erase 0x01d0000 0x380000;sf write 0x80600000 0x1d0000 0x380000
# -- Update U-Boot --
#       
# sf probe; sf erase 0x0 ${flashsize};
# sf write ${baseaddr} 0x0 ${filesize}
# console=ttyS1,115200n8 mem=90M@0x0 rmem=29M@0x5A00000 nmem=9M@0x7700000 init=/linuxrc
# scp -r massimiliano@192.168.1.104:/Users/massimiliano/Downloads/d1-t41/extractions/d1-t41.1.img.extracted/550000/squashfs-root/modules/tx-isp-t41.ko /tmp/
#GPIOs 0-31, platform/10010000.pinctrl, GPA:
# gpio-15  (                    |cim                 ) in  hi    
# gpio-18  (                    |gc5603_reset        ) out hi    
# gpio-19  (                    |gc5603_pwdn         ) out hi    

#GPIOs 32-63, platform/10010000.pinctrl, GPB:
# gpio-49  (                    |?                   ) out lo    
# gpio-50  (                    |?                   ) out lo    
# gpio-57  (                    |?                   ) out lo    
# gpio-58  (                    |SDHCI EXT CD        ) in  hi IRQ
# gpio-59  (                    |?                   ) in  hi    
# gpio-61  (                    |?                   ) out lo    
# gpio-63  (                    |gpio_spk_en         ) out lo    

#GPIOs 64-95, platform/10010000.pinctrl, GPC:
# gpio-76  (                    |?                   ) out hi    
# gpio-81  (                    |?                   ) out hi    
# gpio-82  (                    |?                   ) out lo    

#GPIOs 96-127, platform/10010000.pinctrl, GPD:

BR2_ETHERNET=y
BR2_PACKAGE_WIFI=y
BR2_PACKAGE_WIFI_RTL8733BU=y
#BR2_SENSOR_GC5603=y
BR2_SENSOR_1_NAME=gc5603
#BR2_SENSOR_1_NAME=gc4663
#BR2_PACKAGE_THINGINO_SENSOR_RESET_GPIO=y
#BR2_PACKAGE_THINGINO_SENSOR_RESET_GPIO_PIN=91
BR2_SOC_INGENIC_T41NQ=y
BR2_PACKAGE_THINGINO_UBOOT_FLASH_CONTROLLER_JZ_SFC=n
BR2_PACKAGE_THINGINO_UBOOT_FLASH_CONTROLLER_SFC0_NOR=y
#new
BR2_THINGINO_FLASH_NOR=y
BR2_THINGINO_VPN_WIREGUARD=y
BR2_THINGINO_DEV_PACKAGES=y
BR2_PACKAGE_THINGINO_KOPT_JZ_MAC_V13=y
BR2_PACKAGE_THINGINO_KOPT_I2C=y
BR2_PACKAGE_THINGINO_KOPT_I2C_BUS2=y
#
BR2_PACKAGE_THINGINO_KOPT_MMC0=y
BR2_PACKAGE_THINGINO_KOPT_MMC0_PB_4BIT=y
#BR2_AVPU_APLL=y
#BR2_AVPU_CLK_550MHZ=y
#BR2_ISP_CLK_VPLL=y
#BR2_ISP_CLK_300MHZ=y
#BR2_ISP_CLKS_SCLKA=y
#BR2_ISP_CLKS_550MHZ=y
#BR2_ISP_CLKA_SCLKA=y
#BR2_ISP_CLKA_550MHZ=y
BR2_THINGINO_AUDIO=y
BR2_THINGINO_SDCARD=y
BR2_THINGINO_BUTTON=y
#BR2_THINGINO_RMEM_46=y
BR2_THINGINO_RMEM_MB=29
BR2_THINGINO_NMEM_MB=9

#BR2_THINGINO_RMEM_46=y
#BR2_THINGINO_NMEM_8=y
FLASH_SIZE_MB=16

BR2_LINUX_KERNEL_EXT_THINGINO_KOPT=y
BR2_LINUX_KERNEL_EXT_THINGINO_KOPT_DTS=y
BR2_LINUX_KERNEL_EXT_THINGINO_KOPT_DTS_CAMHI=y

#BR2_LINUX_KERNEL_DTS_SUPPORT=y
#BR2_LINUX_KERNEL_CUSTOM_DTS_PATH="$(BR2_EXTERNAL)/board/ingenic/dts/marmot.dts"
#BR2_LINUX_KERNEL_CUSTOM_CONFIG_FILE="$(BR2_EXTERNAL)/board/ingenic/xburst2/kernel/4.4/t41.generic.config"
```
